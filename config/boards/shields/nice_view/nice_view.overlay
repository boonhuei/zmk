/ {
    chosen {
        zmk,display = &nice_view;
    };
};

&spi0 {
    status = "okay";
    cs-gpios = <&gpio0 6 GPIO_ACTIVE_LOW>;
};

nice_view: nice_view@0 {
    compatible = "sharp,ls013b7dh03";
    reg = <0>;
    spi-max-frequency = <2000000>;
};
